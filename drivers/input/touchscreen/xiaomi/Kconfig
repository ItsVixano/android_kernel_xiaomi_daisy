## drivers/input/touchscreen/xiaomi/daisy-sakura/Kconfig
```kconfig
source "drivers/input/touchscreen/xiaomi/daisy-sakura/ft5446/Kconfig"
source "drivers/input/touchscreen/xiaomi/daisy-sakura/gt917d/Kconfig"
```
